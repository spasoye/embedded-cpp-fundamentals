## CMakeLists.txt
```
cmake_minimum_required(VERSION 3.20.0)

find_package(Zephyr REQUIRED HINTS $ENV{ZEPHYR_BASE})
project(day5_move_semantics)

enable_language(CXX)
set(CMAKE_CXX_STANDARD 17)
set(CMAKE_CXX_FLAGS "${CMAKE_CXX_FLAGS} -fno-exceptions -fno-rtti")
set(CMAKE_CXX_FLAGS "${CMAKE_CXX_FLAGS} -Wall -Wextra")

target_sources(app PRIVATE src/main.cpp)
target_include_directories(app PRIVATE inc)
```

## prj.conf
```kconfig
CONFIG_SERIAL=y
CONFIG_CONSOLE=y
CONFIG_STDOUT_CONSOLE=y
CONFIG_UART_LINE_CTRL=y

CONFIG_USB_DEVICE_STACK_NEXT=y
CONFIG_CDC_ACM_SERIAL_INITIALIZE_AT_BOOT=y
CONFIG_CDC_ACM_SERIAL_PID=0x0004
CONFIG_CDC_ACM_SERIAL_PRODUCT_STRING="Promicro nrf52840 sample"

CONFIG_ENTROPY_GENERATOR=y

CONFIG_CBPRINTF_FP_SUPPORT=y

CONFIG_USE_SEGGER_RTT=y
CONFIG_LOG=y
CONFIG_LOG_BACKEND_RTT=y
CONFIG_LOG_PRINTK=y
CONFIG_LOG_BACKEND_UART=y
# CONFIG_LOG_MODE_IMMEDIATE=y

CONFIG_CPP_EXCEPTIONS=y
CONFIG_CPP=y
```

## src/main.cpp
```c
#include <zephyr/kernel.h>
#include <zephyr/sys/printk.h>
#include "data_buffer.hpp"

template<typename T>
T&& move_helper(T& obj) {
    return static_cast<T&&>(obj);
}

void demo_copy_expensive() {
    printk("\n=== COPY (expensive) ===\n");
    
    printk("\nCreating buff1:\n");
    data_buffer buff1(1024);

    data_buffer buff2 = buff1;

    printk("\nBoth buffers exist:\n");
    printk(" buff1 size: %zu\n", buff1.size());
    printk(" buff2 size: %zu\n", buff2.size());

    printk("\nCopying buf1 to buf3 (COPY assignment):\n");

    data_buffer buff3(512);
    buff3 = buff1;

    printk("\nAll three buffers exist:\n");
    printk("  buff1 size: %zu\n", buff1.size());
    printk("  buff2 size: %zu\n", buff2.size());
    printk("  buff3 size: %zu\n", buff3.size());
}

void demo_move_cheap() {
    printk("\n=== MOVE (cheap) ===\n");

    printk("\nCreating buff1:\n");
    data_buffer buff1(1024);

    printk("Moving buff1 to buff2 ");
    data_buffer buff2 = move_helper(buff1);

    printk("buff1 size: %zu\n", buff1.size());
    printk("buff2 size: %zu\n", buff2.size());

    data_buffer buff3(512);
    buff3 = move_helper(buff2);

    printk("buff1 size: %zu\n", buff1.size());
    printk("buff2 size: %zu (empty)\n", buff2.size());
    printk("buff3 size: %zu (!empty)\n", buff3.size());
}

data_buffer create_buffer() {
    printk("  Creating temporary buffer\n");
    data_buffer temp(2048);
    return temp;  // Automatic move - temp is temporary
}

void demo_automatic_move() {
    printk("\n=== AUTOMATIC MOVE (return value) ===\n");

    printk("\nCalling create buffer():\n");
    data_buffer buf = create_buffer();

    printk("\nReceived buffer:\n");
    printk("  buf size: %zu\n", buf.size());
}

void demo_copy_vs_move_comparison() {
    printk("\n=== COPY vs MOVE Comparison ===\n");
    
    printk("\n--- Scenario 1: COPY (buf1 still needed) ---\n");
    data_buffer buf1(1024);
    data_buffer buf2 = buf1;  // Copy - need both
    printk("Result: Both exist (buf1: %zu, buf2: %zu)\n", 
           buf1.size(), buf2.size());
    
    k_msleep(1000);
    
    printk("\n--- Scenario 2: MOVE (buf3 no longer needed) ---\n");
    data_buffer buf3(1024);
    data_buffer buf4 = move_helper(buf3);  // Move - don't need buf3
    printk("Result: Only buf4 exists (buf3: %zu, buf4: %zu)\n", 
           buf3.size(), buf4.size());
}

int main(void) {
    printk("\n");
    printk("=============================================\n");
    printk("  Week 3 Day 5: Move Semantics\n");
    printk("=============================================\n");
    printk("\nWatch the constructor/destructor messages!\n");
    
    demo_copy_expensive();
    k_msleep(3000);
    
    demo_move_cheap();
    k_msleep(3000);
    
    demo_automatic_move();
    k_msleep(3000);
    
    demo_copy_vs_move_comparison();
    
    printk("\n=============================================\n");
    printk("Copy = Duplicate data (expensive)\n");
    printk("Move = Transfer ownership (cheap)\n");
    printk("=============================================\n\n");
    
    while (1) {
        k_msleep(1000);
    }
}
```

## inc/data_buffer.hpp
```c
#ifndef DATA_BUFFER_HPP
#define DATA_BUFFER_HPP

#include <zephyr/kernel.h>
#include <zephyr/sys/printk.h>
#include <cstdint>


class data_buffer
{
private:
    /* data */
    uint8_t* data_;
    size_t size_;

public:
    data_buffer(size_t size): size_(size), data_(new uint8_t[size]) {
        printk(" [Constructor] Created buffer of %zu bytes\n", size_);

        for (size_t i = 0; i < size_; i++) {
            data_[i] = i % 256;
        }
    }

    ~data_buffer() {
        printk("  [Destructor] Freeing buffer of %zu bytes\n", size_);
        delete[] data_;
    }

    data_buffer(const data_buffer& other) : size_(other.size_) {
        printk(" [COPY constructor] Copying %zu bytes (EXPENSIVE!)\n", size_);
        data_ = new uint8_t[size_];
        memcpy(data_, other.data_, size_);
    }

    data_buffer& operator=(const data_buffer& other){
        printk("  [COPY Assignment] Copying %zu bytes (EXPENSIVE!)\n", other.size_);
        if (this != &other) {
            delete[] data_;
            size_ = other.size_;
            data_ = new uint8_t[size_];
            memcpy(data_, other.data_, size_);
        }
        return *this;
    }

    data_buffer(data_buffer&& other) noexcept : 
        data_(other.data_), size_(other.size_) {
            printk("  [MOVE Constructor] Moving %zu bytes (CHEAP!)\n", size_);
            other.data_ = nullptr;
            other.size_ = 0;
    }

    data_buffer& operator=(data_buffer&& other) noexcept {
        printk("  [MOVE Assignment] Moving %zu bytes (CHEAP!)\n", other.size_);
        if (this != &other) {
            delete[] data_;

            data_ = other.data_;
            size_ = other.size_;

            other.data_ = nullptr;
            other.size_ = 0;
        }

        return *this;
    }
    size_t size() { return size_; }
    uint8_t* data() { return data_; }
};

#endif //DATA_BUFFER_HPP
```
