## CMakeLists.txt
```
cmake_minimum_required(VERSION 3.20.0)

find_package(Zephyr REQUIRED HINTS $ENV{ZEPHYR_BASE})
project(day3_optional)

enable_language(CXX)
set(CMAKE_CXX_STANDARD 17)
set(CMAKE_CXX_FLAGS "${CMAKE_CXX_FLAGS} -fno-exceptions -fno-rtti")
set(CMAKE_CXX_FLAGS "${CMAKE_CXX_FLAGS} -Wall -Wextra")

target_sources(app PRIVATE src/main.cpp)
target_include_directories(app PRIVATE inc)
```

## prj.conf
```kconfig
CONFIG_SERIAL=y
CONFIG_CONSOLE=y
CONFIG_STDOUT_CONSOLE=y
CONFIG_UART_LINE_CTRL=y

CONFIG_USB_DEVICE_STACK_NEXT=y
CONFIG_CDC_ACM_SERIAL_INITIALIZE_AT_BOOT=y
CONFIG_CDC_ACM_SERIAL_PID=0x0004
CONFIG_CDC_ACM_SERIAL_PRODUCT_STRING="Promicro nrf52840 sample"

CONFIG_ENTROPY_GENERATOR=y

CONFIG_CBPRINTF_FP_SUPPORT=y

CONFIG_USE_SEGGER_RTT=y
CONFIG_LOG=y
CONFIG_LOG_BACKEND_RTT=y
CONFIG_LOG_PRINTK=y
CONFIG_LOG_BACKEND_UART=y
# CONFIG_LOG_MODE_IMMEDIATE=y

CONFIG_CPP_EXCEPTIONS=y
```

## src/main.cpp
```c
#include <zephyr/kernel.h>
#include <zephyr/sys/printk.h>
#include "sensor_read.hpp"
#include "battery_monitor.hpp"

void demo_old_style_problems() {
    printk("\n=== Old C-Style Error Handling ===\n");
    
    // Problem 1: Magic value
    int16_t temp = OldSensorRead::read_temperature();
    printk("Temperature: %d°C\n", temp);

    if (temp == -1) {
        printk("  Sensor error detected\n");
    } else {
        printk("  But wait, -1°C is a valid temperature!\n");
    }

    uint8_t humidity;
    bool success = OldSensorRead::read_humidity(&humidity);
    
    if (success) {
        printk("Humidity: %u%%\n", humidity);
    } else {
        printk("Humidity sensor failed\n");
    }
    
    // Problem 3: Easy to forget check
    printk("\nCommon bug - forgot to check return:\n");
    uint8_t hum;
    OldSensorRead::read_humidity(&hum);  // Forgot to check!

    printk("Humidity: %u%% (might be garbage!)\n", hum);
}

void demo_new_optional() {
    printk("\n=== New std::optional example ===\n");

    auto temp = NewSensorRead::read_temperature();

    if (temp.has_value()) {
        printk("Temperature: %d°C\n", temp.value());
    } else {
        printk("Temperature sensor failed\n");
    }

    auto humidity = NewSensorRead::read_humidity();

    if (humidity) {  // Implicit bool conversion
        printk("Humidity: %u%%\n", *humidity);  // Dereference like pointer
    } else {
        printk("Humidity sensor failed\n");
    }
    
    // Can't forget to check - compiler forces you!
    printk("\nType safety:\n");
    printk("  Can't use value without checking has_value()\n");
    printk("  Can't confuse error with valid data\n");
}

void demo_battery_monitor() {
    printk("\n=== Battery Monitor with std::optional ===\n");
    
    // Scenario 1: No battery present
    printk("\nScenario 1: No battery\n");
    battery_monitor::set_battery_present(false);
    
    auto charge = battery_monitor::get_charge_percent();
    auto voltage = battery_monitor::get_voltage_mv();
    
    if (charge.has_value()) {
        printk("  Charge: %u%%\n", charge.value());
    } else {
        printk("  Charge: Not available (no battery)\n");
    }
    
    if (voltage.has_value()) {
        printk("  Voltage: %umV\n", voltage.value());
    } else {
        printk("  Voltage: Not available (no battery)\n");
    }

    // Using value_or() for default
    uint8_t display_charge = battery_monitor::get_charge_or_default(0);
    printk("  Display shows: %u%% (default)\n", display_charge);
    
    k_msleep(1000);
    
    // Scenario 2: Battery present, low charge
    printk("\nScenario 2: Battery low (15%%)\n");
    battery_monitor::set_battery_present(true);
    battery_monitor::set_charge(15);
    
    charge = battery_monitor::get_charge_percent();
    voltage = battery_monitor::get_voltage_mv();
    
    if (charge && voltage) {  // Both have values
        printk("  Charge: %u%%\n", *charge);
        printk("  Voltage: %umV\n", *voltage);
        
        if (*charge < 20) {
            printk("  ⚠ LOW BATTERY WARNING!\n");
        }
    }
    
    k_msleep(1000);
    
    // Scenario 3: Battery present, good charge
    printk("\nScenario 3: Battery healthy (85%%)\n");
    battery_monitor::set_charge(85);
    
    charge = battery_monitor::get_charge_percent();
    voltage = battery_monitor::get_voltage_mv();
    
    if (charge && voltage) {
        printk("  Charge: %u%%\n", *charge);
        printk("  Voltage: %umV\n", *voltage);
        printk("  ✓ Battery OK\n");
    }
    
    // Demonstrate value_or
    printk("\nUsing value_or() for safe defaults:\n");
    battery_monitor::set_battery_present(false);
    uint8_t safe_charge = battery_monitor::get_charge_or_default(100);
    printk("  Charge (or 100 if missing): %u%%\n", safe_charge);
}

int main(void) {
    printk("\n");
    printk("=============================================\n");
    printk("  Week 3 Day 3: std::optional\n");
    printk("=============================================\n");
    
    demo_old_style_problems();
    k_msleep(2000);
    
    demo_new_optional();

    demo_battery_monitor();
    
    printk("\n=============================================\n\n");
    
    while (1) {
        k_msleep(1000);
    }
}
```

## inc/battery_monitor.hpp
```c
#ifndef BATTERY_MONITOR_HPP
#define BATTERY_MONITOR_HPP

#include <cstdint>
#include <optional>

class battery_monitor {
private:
    static bool batt_present_;
    static uint8_t batt_percent_;

public:
    static void set_battery_present(bool present) {
        batt_present_ = present;
    }

    static void set_charge(uint8_t percent) {
        if (percent <= 100) {
            batt_percent_ = percent;
        }
    }

    static std::optional<uint8_t> get_charge_percent() {
        if (!batt_present_) {
            // return {}; or
            return std::nullopt;
        }
    }

    static std::optional<uint16_t> get_voltage_mv() {
        if (!batt_present_) {
            return {};
        }

        uint16_t voltage = 3000 + (batt_percent_ * 12);
        return voltage;
    }

    static uint8_t get_charge_or_default(uint8_t default_val) {
        return get_charge_percent().value_or(default_val);
    }
};


inline bool battery_monitor::batt_present_ = false;
inline uint8_t battery_monitor::batt_percent_ = 0;

#endif
```

## inc/sensor_read.hpp
```c
#ifndef SENSOR_READER_HPP
#define SENSOR_READER_HPP

#include <cstdint>
#include <optional>

class OldSensorRead {
public:
    // Returns -1 on error
    static int16_t read_temperature() {
        // Simulate sensor failure
        bool sensor_ok = false;
        
        if (!sensor_ok) {
            return -1;  // Magic error value - but -1°C is valid!
        }
        return 22;  // 22°C
    }
    
    // Two-parameter pattern (clunky)
    static bool read_humidity(uint8_t* result) {
        bool sensor_ok = false;
        
        if (!sensor_ok) {
            return false;
        }
        *result = 65;  // 65%
        return true;
    }
};


class NewSensorRead{
public:
    static std::optional<uint16_t> read_temperature() {
        bool sensor_ok = false;

        if (!sensor_ok){
            return {};
        }
        return 22;
    }

    static std::optional<uint8_t> read_humidity() {
        bool sensor_ok = false;

        if (!sensor_ok) {
            return std::nullopt;
        }

        return 65;
    }
};

#endif
```
