## CMakeLists.txt
```
cmake_minimum_required(VERSION 3.20.0)

find_package(Zephyr REQUIRED HINTS $ENV{ZEPHYR_BASE})
project(day4_constexpr)

enable_language(CXX)
set(CMAKE_CXX_STANDARD 17)
set(CMAKE_CXX_FLAGS "${CMAKE_CXX_FLAGS} -fno-exceptions -fno-rtti")

target_sources(app PRIVATE src/main.cpp)
target_include_directories(app PRIVATE inc)
```

## prj.conf
```kconfig
CONFIG_SERIAL=y
CONFIG_CONSOLE=y
CONFIG_STDOUT_CONSOLE=y
CONFIG_UART_LINE_CTRL=y

CONFIG_USB_DEVICE_STACK_NEXT=y
CONFIG_CDC_ACM_SERIAL_INITIALIZE_AT_BOOT=y
CONFIG_CDC_ACM_SERIAL_PID=0x0004
CONFIG_CDC_ACM_SERIAL_PRODUCT_STRING="Promicro nrf52840 sample"

CONFIG_ENTROPY_GENERATOR=y

CONFIG_CBPRINTF_FP_SUPPORT=y

CONFIG_USE_SEGGER_RTT=y
CONFIG_LOG=y
CONFIG_LOG_BACKEND_RTT=y
CONFIG_LOG_PRINTK=y
CONFIG_LOG_BACKEND_UART=y
# CONFIG_LOG_MODE_IMMEDIATE=y
```

## src/main.cpp
```c
#include <zephyr/kernel.h>
#include <zephyr/sys/printk.h>
#include "gpio_pin.hpp"

using red_led = GpioPin<15>;

void demo_type_safety() {
    printk("\n=== Type Safety Demo ===\n");
    
    printk("Type-safe operations:\n");
    printk("  ✓ red_led::set_high() - Clear intent\n");
    printk("  ✓ red_led::set(PinState::High) - Explicit state\n");
    printk("\n");
    
    printk("These WON'T compile (commented out):\n");
    printk("  ✗ red_led::set(1) - Wrong type\n");
    printk("  ✗ red_led::set_high(15) - Shouldn't need pin number\n");
    printk("\n");
    
    // Demonstrate type-safe operations
    red_led::set(PinState::high);
    k_msleep(500);
    red_led::set(PinState::low);
    k_msleep(500);
    
    // These would cause compile errors:
    // red_led::set(1);           // ERROR: int is not PinState
    // red_led::set_high(15);     // ERROR: no parameter expected
}

int main(void){
    red_led::configure_output();
    printk("Blinking LED three times...\n");

    for (uint8_t cnt = 0; cnt < 3; cnt++){
        red_led::set_high();
        k_msleep(500);
        red_led::set_low();
        k_msleep(500);
    }

    demo_type_safety();
    
    printk("Done!\n");

    while (1) {
        k_msleep(1000);
    }
}
```

## inc/gpio_config.hpp
```c
#ifndef GPIO_CONFIG_HPP
#define GPIO_CONFIG_HPP

#include <cstdint>

class PinNumber{
private:
    uint8_t pin_;

public:
    explicit constexpr PinNumber(uint8_t pin) : pin_(pin) {}

    constexpr uint8_t value() const { return pin_; }
};

enum class PinState : uint8_t {
    low = 0,
    high = 1
};

#endif
```

## inc/gpio_pin.hpp
```c
#ifndef GPIO_PIN_HPP
#define GPIO_PIN_HPP

#include "gpio_port.hpp"

template<uint8_t Pin, typename Port = GpioP0>
class GpioPin {
private:
    static constexpr PinNumber pin_num_{Pin};

public:
    static_assert(Pin < 32, "Pin number must be 0-31");

    static void configure_output() {
        Port::configure_output(pin_num_);
    }

    static void configure_input() {
        Port::configure_input(pin_num_);
    }

    static void set_high() {
        Port::set_high(pin_num_);
    }

    static void set_low() {
        Port::set_low(pin_num_);
    }

    static void set(PinState state) {
        Port::set(pin_num_, state);
    }

    static void toggle() {
        Port::toggle(pin_num_);
    }

    static PinState read() {
        return Port::read(pin_num_);
    }

    static bool is_high() {
        return read() == PinState::high;
    }

    static bool is_low() {
        return read() == PinState::low;
    }
};

#endif
```

## inc/gpio_port.hpp
```c
#ifndef GPIO_PORT_HPP
#define GPIO_PORT_HPP

#include "register.hpp"
#include "gpio_config.hpp"

template<uint32_t BaseAddr>
class GpioPort{
private:
    // nrf52840 registers offset
    static constexpr uint32_t OUT_OFFSET    = 0x504;
    static constexpr uint32_t OUTSET_OFFSET = 0x508;
    static constexpr uint32_t OUTCLR_OFFSET = 0x50C;
    static constexpr uint32_t IN_OFFSET     = 0x510;
    static constexpr uint32_t DIR_OFFSET    = 0x514;
    static constexpr uint32_t DIRSET_OFFSET = 0x518;
    static constexpr uint32_t DIRCLR_OFFSET = 0x51C;

    // Create Register types for each hardware register
    using OutReg     = Register<BaseAddr + OUT_OFFSET>;
    using OutSetReg  = Register<BaseAddr + OUTSET_OFFSET>;
    using OutClrReg  = Register<BaseAddr + OUTCLR_OFFSET>;
    using InReg      = Register<BaseAddr + IN_OFFSET>;
    using DirReg     = Register<BaseAddr + DIR_OFFSET>;
    using DirSetReg  = Register<BaseAddr + DIRSET_OFFSET>;
    using DirClrReg  = Register<BaseAddr + DIRCLR_OFFSET>;

public:
    static void configure_output(PinNumber pin) {
        DirSetReg::write(1U << pin.value());
    }

    static void configure_input(PinNumber pin) {
        DirClrReg::write(1U << pin.value());
    }

    static void set(PinNumber pin, PinState state) {
        if (state == PinState::high) {
            OutSetReg::write(1U << pin.value());
        }
        else {
            OutClrReg::write(1U << pin.value());
        }
    }

    static void set_high(PinNumber pin){
        OutSetReg::write(1U << pin.value());
    }

    static void set_low(PinNumber pin){
        OutClrReg::write(1U << pin.value());
    }

    static PinState read(PinNumber pin){
        return InReg::is_bit_set(pin.value()) ? PinState::high : PinState::low;
    }

    static void toggle(PinNumber pin){
        if (OutReg::is_bit_set(pin.value())) {
            OutClrReg::write(1U << pin.value());
        } else {
            OutSetReg::write(1U << pin.value());
        }
    }
};

using GpioP0 = GpioPort<0x50000000>;


#endif
```

## inc/register.hpp
```c
#ifndef REGISTER_HPP
#define REGISTER_HPP

#include <cstdint>

template<uint32_t addr>
class Register {
public:
    static void write(uint32_t value) {
        // usual embedded c: *(volatile uint32_t*)addr = value;
        *reinterpret_cast<volatile uint32_t*>(addr) = value;
    }

    static uint32_t read() {
        return *reinterpret_cast<volatile uint32_t*>(addr);
    }

    static void set_bit(uint8_t bit) {
        write(read() | (1U << bit));
    }

    static void clear_bit(uint8_t bit) {
        write(read() & ~(1U << bit));
    }

    static void set_bits(uint32_t mask) {
        write(read() | mask);
    }

    static void clear_bits(uint8_t mask) {
        write(read() & ~mask);
    }

    static bool is_bit_set(uint8_t bit) {
        return *reinterpret_cast<volatile uint32_t*>(addr) & (1U << bit);
    }
};

#endif
```
