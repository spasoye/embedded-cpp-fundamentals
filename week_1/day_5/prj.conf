## CMakeLists.txt
```
cmake_minimum_required(VERSION 3.20.0)

# Set devicetree overlay file
set(DTC_OVERLAY_FILE ${CMAKE_CURRENT_SOURCE_DIR}/boards/promicro_nrf52840.overlay)

find_package(Zephyr REQUIRED HINTS $ENV{ZEPHYR_BASE})
project(cpp_embedded_fundamentals)

# Enable C++ support
enable_language(CXX)

# Set C++ standard
set(CMAKE_CXX_STANDARD 17)
set(CMAKE_CXX_STANDARD_REQUIRED ON)

# Disable features not needed in embedded
set(CMAKE_CXX_FLAGS "${CMAKE_CXX_FLAGS} -fno-exceptions")
set(CMAKE_CXX_FLAGS "${CMAKE_CXX_FLAGS} -fno-rtti")

# Your source files
target_sources(app PRIVATE 
     src/main.cpp
     src/spi_session.cpp
     src/led.cpp
     src/button.cpp
     src/critical_section.cpp
)

target_include_directories(app PRIVATE inc)
```

## prj.conf
```kconfig
CONFIG_SERIAL=y
CONFIG_CONSOLE=y
CONFIG_STDOUT_CONSOLE=y
CONFIG_UART_LINE_CTRL=y

CONFIG_USB_DEVICE_STACK_NEXT=y
CONFIG_CDC_ACM_SERIAL_INITIALIZE_AT_BOOT=y
CONFIG_CDC_ACM_SERIAL_PID=0x0004
CONFIG_CDC_ACM_SERIAL_PRODUCT_STRING="Promicro nrf52840 sample"

CONFIG_ENTROPY_GENERATOR=y

CONFIG_USE_SEGGER_RTT=y
CONFIG_LOG=y
CONFIG_LOG_BACKEND_RTT=y
CONFIG_LOG_PRINTK=y
CONFIG_LOG_BACKEND_UART=y
# CONFIG_LOG_MODE_IMMEDIATE=y
```

## inc/critical_section.hpp
```c
#ifndef CRITICAL_SECTION_HPP
#define CRITICAL_SECTION_HPP

#include <zephyr/kernel.h>

class critical_section{
    public:
        critical_section();
        ~critical_section();

        critical_section(const critical_section&) = delete;
        critical_section& operator=(const critical_section&) = delete;

    private:
        uint8_t key_;
};



#endif // CRITICAL_SECTION_H
```

## inc/spi_session.hpp
```c
#ifndef SPI_SESSION_HPP
#define SPI_SESSION_HPP

#include <zephyr/drivers/spi.h>
#include <zephyr/kernel.h>

class SpiSession {
public:
    SpiSession(const struct device* spi_dev);
    ~SpiSession();

    int transfer_byte(uint8_t tx_byte, uint8_t* rx_byte);

    // TODO: wtf
    SpiSession(const SpiSession&) = delete;
    SpiSession& operator=(const SpiSession&) = delete;

private:
    const struct device* spi_dev_;
};

#endif
```

## src/button.cpp
```c
#include "button.hpp"
#include <zephyr/kernel.h>
#include <zephyr/drivers/gpio.h>
#include <zephyr/sys/printk.h>

Button::Button(const struct gpio_dt_spec& spec) : spec_(spec){
    gpio_pin_configure_dt(&spec_, GPIO_INPUT);
    printk("Button constructed\n");
}

Button::~Button(){
    gpio_pin_configure_dt(&spec_, GPIO_DISCONNECTED);
    printk("Button destructed\n");
}

bool Button::is_pressed() const{
    return gpio_pin_get_dt(&spec_) == 1;
}
```

## src/critical_section.cpp
```c
#include "critical_section.hpp"
#include <zephyr/sys/printk.h>

critical_section::critical_section() {
    key_ = irq_lock();  // Disable interrupts, save state
    printk("[IRQ LOCKED - interrupts disabled]\n");
}

critical_section::~critical_section() {
    irq_unlock(key_);  // Restore interrupts
    printk("[IRQ UNLOCKED - interrupts restored]\n");
}
```

## src/led.cpp
```c
#include "led.hpp"
#include <zephyr/kernel.h>
#include <zephyr/sys/printk.h>

Led::Led(const struct gpio_dt_spec& spec) : spec_(spec), state_(false) {
        // Configure GPIO in constructor
        printk("LED construted\n");
        gpio_pin_configure_dt(&spec_, GPIO_OUTPUT_INACTIVE);
    }
    
Led::~Led(){
    gpio_pin_configure_dt(&spec_, GPIO_DISCONNECTED);
    printk("LED destructed\n");
}

void Led::on() {
    // printk("Turning LED on\n");
    gpio_pin_set_dt(&spec_, 1);
    state_ = true;
}

void Led::off() {
    // printk("Turning LED off\n");
    gpio_pin_set_dt(&spec_, 0);
    state_ = false;
}

void Led::toggle() {
    state_ = !state_;
    
    if (state_) {
        on();
    } else {
        off();
    }
}
```
