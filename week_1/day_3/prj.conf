## CMakeLists.txt
```
cmake_minimum_required(VERSION 3.20.0)

# Set devicetree overlay file
set(DTC_OVERLAY_FILE ${CMAKE_CURRENT_SOURCE_DIR}/boards/promicro_nrf52840.overlay)

find_package(Zephyr REQUIRED HINTS $ENV{ZEPHYR_BASE})
project(cpp_embedded_fundamentals)

# Enable C++ support
enable_language(CXX)

# Set C++ standard
set(CMAKE_CXX_STANDARD 17)
set(CMAKE_CXX_STANDARD_REQUIRED ON)

# Disable features not needed in embedded
set(CMAKE_CXX_FLAGS "${CMAKE_CXX_FLAGS} -fno-exceptions")
set(CMAKE_CXX_FLAGS "${CMAKE_CXX_FLAGS} -fno-rtti")

# Your source files
target_sources(app PRIVATE 
     src/main.cpp
     src/spi_session.cpp
     src/led.cpp
     src/button.cpp
)

target_include_directories(app PRIVATE inc)
```

## prj.conf
```kconfig
CONFIG_SERIAL=y
CONFIG_CONSOLE=y
CONFIG_UART_CONSOLE=y
CONFIG_STDOUT_CONSOLE=y
CONFIG_UART_LINE_CTRL=y

CONFIG_USB_DEVICE_STACK_NEXT=y
CONFIG_CDC_ACM_SERIAL_INITIALIZE_AT_BOOT=y
CONFIG_CDC_ACM_SERIAL_PID=0x0004
CONFIG_CDC_ACM_SERIAL_PRODUCT_STRING="Promicro nrf52840 sample"

CONFIG_ENTROPY_GENERATOR=y
```

## src/main.cpp
```c
#include "spi_session.hpp"
#include <zephyr/drivers/spi.h>
#include <zephyr/sys/printk.h>
#include "led.hpp"
#include "button.hpp"

#define SPI_NODE     DT_NODELABEL(spi#)
#define LED0_NODE    DT_ALIAS(led0)
#define BUTTON0_NODE DT_ALIAS(sw0)

static const struct gpio_dt_spec led_spec = GPIO_DT_SPEC_GET(LED0_NODE, gpios);
static const struct gpio_dt_spec btn_spec = GPIO_DT_SPEC_GET(BUTTON0_NODE, gpios);
/* Demonstration 
const struct device* spi_dev = DEVICE_DT_GET(SPI_NODE);
*/
// Simulate reading flash chip ID
void read_flash_id() {
    printk("\n=== Reading Flash ID ===\n");
    
    uint8_t manufacturer_id;
    uint8_t device_id[2];
    
    {
        SpiSession spi(nullptr);  // SPI enabled HERE
        
        spi.transfer_byte(0x9F, nullptr);          // JEDEC ID command
        spi.transfer_byte(0x00, &manufacturer_id);
        spi.transfer_byte(0x00, &device_id[0]);
        spi.transfer_byte(0x00, &device_id[1]);
        
    }  // ← SPI disabled HERE automatically!
    
    // Process data WITHOUT SPI consuming power
    printk("Manufacturer: 0x%02X\n", manufacturer_id);
    printk("Device: 0x%02X%02X\n", device_id[0], device_id[1]);
    printk("=== Flash read complete ===\n\n");
}

// Simulate writing to flash
void write_flash_byte(uint32_t address, uint8_t data) {
    printk("\n=== Writing to Flash ===\n");
    printk("Address: 0x%06X, Data: 0x%02X\n", address, data);
    
    {
        SpiSession spi(nullptr);  // SPI enabled
        
        // Write enable command
        spi.transfer_byte(0x06, nullptr);
        
    }  // SPI disabled
    
    k_msleep(1);  // Small delay (SPI not consuming power)
    
    {
        SpiSession spi(nullptr);  // SPI enabled again
        
        // Page program command
        spi.transfer_byte(0x02, nullptr);
        spi.transfer_byte((address >> 16) & 0xFF, nullptr);
        spi.transfer_byte((address >> 8) & 0xFF, nullptr);
        spi.transfer_byte(address & 0xFF, nullptr);
        spi.transfer_byte(data, nullptr);
        
    }  // SPI disabled
    
    printk("=== Write complete ===\n\n");
}

int main() {
    Led led(led_spec);
    Button button(btn_spec);
    
    printk("\n=== Day 3: SPI Session RAII Demo ===\n\n");
    
    // Demonstrate RAII scope control
    read_flash_id();
    k_msleep(1000);
    read_flash_id();
    
    // Main loop
    while (1) {
        if (button.is_pressed()) {
            led.on();
            read_flash_id();  // SPI only active during this call
        } else {
            led.off();
        }
        
        k_msleep(100);
    }
}
```

## inc/led.hpp
```c
#ifndef LED_HPP
#define LED_HPP

#include <zephyr/drivers/gpio.h>

class Led {
    private:
        const struct gpio_dt_spec& spec_;
        bool state_;

    public:
        Led(const struct gpio_dt_spec& spec);
        ~Led();
        void on();
        void off();
        void toggle();

};

#endif
```

## src/button.cpp
```c
#include "button.hpp"
#include <zephyr/kernel.h>
#include <zephyr/drivers/gpio.h>
#include <zephyr/sys/printk.h>

Button::Button(const struct gpio_dt_spec& spec) : spec_(spec){
    gpio_pin_configure_dt(&spec_, GPIO_INPUT);
    printk("Button constructed\n");
}

Button::~Button(){
    gpio_pin_configure_dt(&spec_, GPIO_DISCONNECTED);
    printk("Button destructed\n");
}

bool Button::is_pressed() const{
    return gpio_pin_get_dt(&spec_) == 0; 
}
```

## src/spi_session.cpp
```c
#include "spi_session.hpp"
#include <zephyr/drivers/spi.h>
#include <zephyr/sys/printk.h>
// TODO: fiddle with prj.conf ?
#include <zephyr/random/random.h>
#include <zephyr/kernel.h>

SpiSession::SpiSession(const struct device* spi_dev) : spi_dev_(spi_dev) {
    /*
        * This is dummy example and no actual SPI transfer is performed. In a real implementation, you would set up the SPI configuration and perform necessary initialization here. This is just to demonstrate how to structure the class and handle the SPI device.
    */
    if (!device_is_ready(spi_dev_)) {
        printk("SPI device not ready\n");
    }
    printk("SPI session started\n");
}

SpiSession::~SpiSession() {
    printk("SPI session ended\n");

}

int SpiSession::transfer_byte(uint8_t tx_byte, uint8_t* rx_byte){
    printk("SPI transfer TX=0x%02X", tx_byte);

    /*
        * simulate a delay for the SPI transfer. In a real implementation, you would perform the actual SPI transfer.
    */
    if (rx_byte) {
        // Random byte
        *rx_byte = sys_rand8_get();
        printk(" RX=0x%02X\n", *rx_byte);
    }
    printk("\n");

    return 0;
}
```
